## conf/layer.conf
```bitbake
# We have a conf and classes directory, add to BBPATH
BBPATH .= ":${LAYERDIR}"

# We have recipes-* directories, add to BBFILES
BBFILES += "${LAYERDIR}/recipes-*/*/*.bb \
	${LAYERDIR}/recipes-*/*/*.bbappend"

BBFILE_COLLECTIONS += "aragua"
BBFILE_PATTERN_aragua = "^${LAYERDIR}/"
BBFILE_PRIORITY_aragua = "6"
```

## conf/machine/eukrea-cpuimx51.conf
```bitbake
#@TYPE: Machine
#@Name: EUKREA CPUIMX51
#@DESCRIPTION: Machine configuration for Freescale i.MX51 based Eukrea CPUIMX51 + baseboard

MACHINE_FEATURES = "kernel26 apm alsa ext2 ext3 usbhost usbgadget screen camera can touchscreen bluetooth ppp"

GUI_MACHINE_CLASS = "bigscreen"

#require conf/machine/include/eukrea.inc
require conf/machine/include/tune-cortexa8.inc

XSERVER = "xserver-xorg \
           xf86-input-tslib \
           xf86-input-keyboard \
           xf86-input-mouse \
           xf86-video-fbdev"

SERIAL_CONSOLE ?= "115200 ttymxc0"

ROOT_FLASH_SIZE = "256"
IMAGE_FSTYPES += "ubi tar.bz2"

# NAND
MKUBIFS_ARGS = "-m 2048 -e 129024 -c 8152"
UBINIZE_ARGS = "-m 2048 -p 128KiB -s 512"

PREFERRED_PROVIDER_virtual/bootloader = "barebox"
#PREFERRED_VERSION_barebox = "2012.09.0"
PREFERRED_VERSION_barebox = "2015.11.0"
BAREBOX_MACHINE = "eukrea_cpuimx51"
UBOOT_ENTRYPOINT = "0x90008000"
UBOOT_LOADADDRESS = "0x90008000"

EXTRA_IMAGECMD_jffs2 = "--little-endian --eraseblock=0x20000 -n \
    --pad ; sumtool --eraseblock=0x20000 -n \
    --littleendian --pad \
    -i ${DEPLOY_DIR_IMAGE}/${IMAGE_NAME}.rootfs.jffs2 \
    -o ${DEPLOY_DIR_IMAGE}/${IMAGE_NAME}.rootfs.jffs2.summary"


PREFERRED_PROVIDER_virtual/kernel ?= "linux-yocto"
PREFERRED_VERSION_linux-yocto ?= "3.19%"
#PREFERRED_PROVIDER_virtual/kernel ?= "linux"
#PREFERRED_VERSION_linux ?= "3.4%"
KERNEL_IMAGETYPE = "uImage"
KERNEL_DEVICETREE = "imx51-eukrea-mbimxsd51-baseboard.dtb"
KERNEL_EXTRA_ARGS += "LOADADDR=${UBOOT_ENTRYPOINT}"

MACHINE_EXTRA_RRECOMMENDS = " kernel-modules kernel-devicetree"

EXTRA_IMAGEDEPENDS += "virtual/bootloader"
```

## conf/machine/include/eukrea.inc
```bitbake
# use SOC_FAMILY to have an override for all our machines
SOC_FAMILY = "eukrea"
require conf/machine/include/soc-family.inc
```

## conf/machine/riotboard.conf
```bitbake
#@TYPE: Machine
#@NAME: element14 i.MX6 riotboard Solo
#@SOC: i.MX6S
#@DESCRIPTION: Machine configuration for i.MX6 riotboard
#@MAINTAINER: Fabien Lahoudere <fabienlahoudere.pro@gmail.com>

# Define imx6 default behaviour
include conf/machine/include/imx-base.inc
include conf/machine/include/tune-cortexa9.inc

# Define riotboard kernel specific configuration
PREFERRED_PROVIDER_virtual/kernel ?= "linux-riotboard"
PREFERRED_VERSION_linux-riotboard ?= "3.14.15"

KERNEL_DEVICETREE = "imx6dl-riotboard.dtb"

KERNEL_IMAGETYPE = "uImage"

SERIAL_CONSOLE = "115200 ttymxc1"
IMAGE_FSTYPES +="ubi ext3 sdcard"
MKUBIFS_ARGS = " -m 512 -e 15360 -c 6000 "
UBINIZE_ARGS = " -p 16KiB -m 512 -s 512 "

SOC_FAMILY = "mx6:mx6dl"

UBOOT_MACHINE = "riotboard_config"
```
